## config/boards/shields/uni_v2/Kconfig.defconfig
```kconfig
config SHIELD_UNI_V2
    def_bool $(shields_list_contains,uni_v2)

choice ZMK_HID_REPORT_TYPE
    default ZMK_HID_REPORT_TYPE_NKRO
endchoice
```

## config/boards/shields/uni_v2/Kconfig.shield
```kconfig
if SHIELD_UNI_V2

config ZMK_KEYBOARD_NAME
    default "Uni V2"

endif

config ZMK_HID_REPORT_TYPE = y
```

## config/west.yml
```yaml
manifest:
  remotes:
    - name: zmkfirmware
      url-base: https://github.com/zmkfirmware
    - name: apostrophes
      url-base: https://github.com/apostrophes
  projects:
    - name: zmk
      remote: apostrophes
      revision: core/hid-nkro-configurable-support
      import: app/west.yml
  self:
    path: config
```
